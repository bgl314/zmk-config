## config/west.yml
```yaml
manifest:
  remotes:
    - name: zmkfirmware
      url-base: https://github.com/zmkfirmware
      name: bgl314
      url-base: https://github.com/bgl314
  projects:
    - name: zmk
      remote: bgl314
      revision: main
      import: app/west.yml
  self:
    path: config
```
